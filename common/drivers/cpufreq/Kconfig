## common/drivers/cpufreq/Kconfig
```kconfig
config CPU_FREQ
	bool "CPU Frequency scaling"
	help
	  CPU Frequency scaling allows you to change the clock speed of 
	  CPUs on the fly. This is a nice method to save power, because 
	  the lower the CPU clock speed, the less power the CPU consumes.

	  Note that this driver doesn't automatically change the CPU
	  clock speed, you need to either enable a dynamic cpufreq governor
	  (see below) after boot, or use a userspace tool.

	  For details, take a look at <file:Documentation/cpu-freq>.

	  If in doubt, say N.

if CPU_FREQ

config CPU_FREQ_TABLE
	tristate

config CPU_FREQ_DEBUG
	bool "Enable CPUfreq debugging"
	help
	  Say Y here to enable CPUfreq subsystem (including drivers)
	  debugging. You will need to activate it via the kernel
	  command line by passing
	     cpufreq.debug=<value>

	  To get <value>, add 
	       1 to activate CPUfreq core debugging,
	       2 to activate CPUfreq drivers debugging, and
	       4 to activate CPUfreq governor debugging

config CPU_FREQ_STAT
	tristate "CPU frequency translation statistics"
	select CPU_FREQ_TABLE
	default y
	help
	  This driver exports CPU frequency statistics information through sysfs
	  file system.

	  To compile this driver as a module, choose M here: the
	  module will be called cpufreq_stats.

	  If in doubt, say N.

config CPU_FREQ_STAT_DETAILS
	bool "CPU frequency translation statistics details"
	depends on CPU_FREQ_STAT
	help
	  This will show detail CPU frequency translation table in sysfs file
	  system.

	  If in doubt, say N.

choice
	prompt "Default CPUFreq governor"
	default CPU_FREQ_DEFAULT_GOV_SMARTASS2
	help
	  This option sets which CPUFreq governor shall be loaded at
	  startup. If in doubt, select 'performance'.

config CPU_FREQ_DEFAULT_GOV_PERFORMANCE
	bool "performance"
	select CPU_FREQ_GOV_PERFORMANCE
	help
	  Use the CPUFreq governor 'performance' as default. This sets
	  the frequency statically to the highest frequency supported by
	  the CPU.

config CPU_FREQ_DEFAULT_GOV_POWERSAVE
	bool "powersave"
	depends on EMBEDDED
	select CPU_FREQ_GOV_POWERSAVE
	help
	  Use the CPUFreq governor 'powersave' as default. This sets
	  the frequency statically to the lowest frequency supported by
	  the CPU.

config CPU_FREQ_DEFAULT_GOV_BRAZILIANWAX
	bool "brazilianwax"
	select CPU_FREQ_GOV_BRAZILIANWAX
	select CPU_FREQ_GOV_PERFORMANCE
	help
	  Use the CPUFreq governor 'brazilianwax as default.

config CPU_FREQ_DEFAULT_GOV_POWERSAVE
	bool "powersave"
	depends on EMBEDDED
	select CPU_FREQ_GOV_POWERSAVE
	help
	  Use the CPUFreq governor 'powersave' as default. This sets
	  the frequency statically to the lowest frequency supported by
	  the CPU.

config CPU_FREQ_DEFAULT_GOV_ONDEMAND
	bool "ondemand"
	select CPU_FREQ_GOV_ONDEMAND
	select CPU_FREQ_GOV_PERFORMANCE
	help
	  Use the CPUFreq governor 'ondemand' as default. This allows
	  you to get a full dynamic frequency capable system by simply
	  loading your cpufreq low-level hardware driver.
	  Be aware that not all cpufreq drivers support the ondemand
	  governor. If unsure have a look at the help section of the
	  driver. Fallback governor will be the performance governor.

config CPU_FREQ_DEFAULT_GOV_SMOOTHASS
	bool "smoothass"
	select CPU_FREQ_GOV_SMOOTHASS
	select CPU_FREQ_GOV_PERFORMANCE
	help
	  Use the CPUFreq governor 'smoothass' as default.

config CPU_FREQ_DEFAULT_GOV_INTERACTIVE
	bool "interactive"
	select CPU_FREQ_GOV_INTERACTIVE
	help
	  Use the CPUFreq governor 'interactive' as default. This allows
	  you to get a full dynamic cpu frequency capable system by simply
	  loading your cpufreq low-level hardware driver, using the
	  'interactive' governor for latency-sensitive workloads.

config CPU_FREQ_DEFAULT_GOV_CONSERVATIVE
	bool "conservative"
	select CPU_FREQ_GOV_CONSERVATIVE
	select CPU_FREQ_GOV_PERFORMANCE
	help
	  Use the CPUFreq governor 'conservative' as default. This allows
	  you to get a full dynamic frequency capable system by simply
	  loading your cpufreq low-level hardware driver.
	  Be aware that not all cpufreq drivers support the conservative
	  governor. If unsure have a look at the help section of the
	  driver. Fallback governor will be the performance governor.

config CPU_FREQ_DEFAULT_GOV_BCM21553
	bool "bcm21553"
	select CPU_FREQ_GOV_BCM21553
	help
	  Use the CPUFreq governor 'bcm21553' as default. This option enables
	  CPUFReq governor implemented for Broadcom BCM21553 chip. This
	  governor adjusts the cpu frequency and voltage based on certain
	  usecases.

config CPU_FREQ_DEFAULT_GOV_SMARTASS2
	bool "smartass2"
	select CPU_FREQ_GOV_SMARTASS2
	help
	  Use the CPUFreq governor 'smartassV2' as default.

config CPU_FREQ_DEFAULT_GOV_INTERACTIVEX
	bool "interactiveX"
	select CPU_FREQ_GOV_INTERACTIVEX
	help
	  Use the CPUFreq governor 'interactiveX' as default. This allows
	  you to get a full dynamic cpu frequency capable system by simply
	  loading your cpufreq low-level hardware driver, using the
	  'interactiveX' governor for latency-sensitive workloads.

config CPU_FREQ_DEFAULT_GOV_LAGFREE
	bool "lagfree"
	select CPU_FREQ_GOV_LAGFREE
	select CPU_FREQ_GOV_PERFORMANCE
	help
	  Use the CPUFreq governor 'lagfree' as default. This allows
	  you to get a full dynamic frequency capable system by simply
	  loading your cpufreq low-level hardware driver.
	  Be aware that not all cpufreq drivers support the lagfree
	  governor. If unsure have a look at the help section of the
	  driver. Fallback governor will be the performance governor.

config CPU_FREQ_DEFAULT_GOV_LIONHEART
       bool "lionheart"
       select CPU_FREQ_GOV_LIONHEART
       help
         Use the CPUFreq governor 'Lionheart' as default.

config CPU_FREQ_DEFAULT_GOV_ONDEMANDX
       bool "ondemandx"
       select CPU_FREQ_GOV_ONDEMANDX
       select CPU_FREQ_GOV_PERFORMANCE
       help
         Use the CPUFreq governor 'ondemand' as default. This allows
         you to get a full dynamic frequency capable system by simply
         loading your cpufreq low-level hardware driver.
         Be aware that not all cpufreq drivers support the ondemand
         governor. If unsure have a look at the help section of the
         driver. Fallback governor will be the performance governor.
         OndemandX has built in sleep profile, but not working Sysfs
         interface.

endchoice

config CPU_FREQ_GOV_PERFORMANCE
	tristate "'performance' governor"
	help
	  This cpufreq governor sets the frequency statically to the
	  highest available CPU frequency.

	  To compile this driver as a module, choose M here: the
	  module will be called cpufreq_performance.

	  If in doubt, say Y.

config CPU_FREQ_GOV_POWERSAVE
	tristate "'powersave' governor"
	help
	  This cpufreq governor sets the frequency statically to the
	  lowest available CPU frequency.

	  To compile this driver as a module, choose M here: the
	  module will be called cpufreq_powersave.

	  If in doubt, say Y.

config CPU_FREQ_GOV_SMOOTHASS
	tristate "'smoothass' cpufreq governor"
	depends on CPU_FREQ
	help
	  smoothass' - a "slightly more agressive smartass" governor!
 
	  If in doubt, say N.

config CPU_FREQ_GOV_SMOOTHASS_INPUT
	bool "Ramp up CPU frequency on input events"
	default y
	depends on CPU_FREQ_GOV_SMOOTHASS
	help
	  Enable installation of an input event handler which will ramp up the
	  CPU to max frequency when an input event is received.

config CPU_FREQ_GOV_INTERACTIVEX
	tristate "'interactiveX' cpufreq policy governor"
	help
	  'interactiveX' - Modified version of interactive with sleep+wake code.

config CPU_FREQ_GOV_INTERACTIVEX_INPUT
       bool "Ramp up CPU frequency on input events"
       default y
       depends on CPU_FREQ_GOV_INTERACTIVEX
       help
         Enable installation of an input event handler which will ramp up the
         CPU to max frequency when an input event is received.

config CPU_FREQ_GOV_ONDEMAND
	tristate "'ondemand' cpufreq policy governor"
	select CPU_FREQ_TABLE
	help
	  'ondemand' - This driver adds a dynamic cpufreq policy governor.
	  The governor does a periodic polling and 
	  changes frequency based on the CPU utilization.
	  The support for this governor depends on CPU capability to
	  do fast frequency switching (i.e, very low latency frequency
	  transitions). 

	  To compile this driver as a module, choose M here: the
	  module will be called cpufreq_ondemand.

	  For details, take a look at linux/Documentation/cpu-freq.

	  If in doubt, say N.

config CPU_FREQ_GOV_ONDEMAND_INPUT
	bool "Ramp up CPU frequency on input events"
	default y
	depends on CPU_FREQ_GOV_ONDEMAND
	help
	  Enable installation of an input event handler which will ramp up the
	  CPU to max frequency when an input event is received.

config CPU_FREQ_GOV_INTERACTIVE
	tristate "'interactive' cpufreq policy governor"
	help
	  'interactive' - This driver adds a dynamic cpufreq policy governor
	  designed for latency-sensitive workloads. 

	  To compile this driver as a module, choose M here: the
	  module will be called cpufreq_ondemand.

	  For details, take a look at linux/Documentation/cpu-freq.

	  If in doubt, say N.

config CPU_FREQ_GOV_INTERACTIVE_INPUT
	bool "Ramp up CPU frequency on input events"
	default y
	depends on CPU_FREQ_GOV_INTERACTIVE
	help
	  Enable installation of an input event handler which will ramp up the
	  CPU to max frequency when an input event is received.

config CPU_FREQ_GOV_CONSERVATIVE
	tristate "'conservative' cpufreq governor"
	depends on CPU_FREQ
	help
	  'conservative' - this driver is rather similar to the 'ondemand'
	  governor both in its source code and its purpose, the difference is
	  its optimisation for better suitability in a battery powered
	  environment.  The frequency is gracefully increased and decreased
	  rather than jumping to 100% when speed is required.

	  If you have a desktop machine then you should really be considering
	  the 'ondemand' governor instead, however if you are using a laptop,
	  PDA or even an AMD64 based computer (due to the unacceptable
	  step-by-step latency issues between the minimum and maximum frequency
	  transitions in the CPU) you will probably want to use this governor.

	  To compile this driver as a module, choose M here: the
	  module will be called cpufreq_conservative.

	  For details, take a look at linux/Documentation/cpu-freq.

	  If in doubt, say N.

config CPU_FREQ_GOV_CONSERVATIVE_INPUT
	bool "Ramp up CPU frequency on input events"
	default y
	depends on CPU_FREQ_GOV_CONSERVATIVE
	help
	  Enable installation of an input event handler which will ramp up the
	  CPU to max frequency when an input event is received.

	  If in doubt, say N.

config CPU_FREQ_GOV_SMARTASS2
	tristate "'smartassV2' cpufreq governor"
	depends on CPU_FREQ
	help
	  'smartassV2' - a "smart" optimized governor for the BCM21553!
	
	  If in doubt, say N.

config CPU_FREQ_GOV_SMARTASS2_INPUT
	bool "Ramp up CPU frequency on input events"
	default y
	depends on CPU_FREQ_GOV_SMARTASS2
	help
	  Enable installation of an input event handler which will ramp up the
	  CPU to max frequency when an input event is received.

	  If in doubt, say N.

config CPU_FREQ_GOV_LAGFREE
        tristate "'lagfree' cpufreq governor"
        depends on CPU_FREQ
        help
          'lagfree' - this driver is rather similar to the 'ondemand'
          governor both in its source code and its purpose, the difference is
          its optimisation for better suitability in a battery powered
          environment. The frequency is gracefully increased and decreased
          rather than jumping to 100% when speed is required.

          To compile this driver as a module, choose M here: the
          module will be called cpufreq_lagfree.

          For details, take a look at linux/Documentation/cpu-freq.

          If in doubt, say N.

config CPU_FREQ_GOV_LAGFREE_INPUT
	bool "Ramp up CPU frequency on input events"
	default y
	depends on CPU_FREQ_GOV_LAGFREE
	help
	  Enable installation of an input event handler which will ramp up the
	  CPU to max frequency when an input event is received.

config CPU_FREQ_GOV_LIONHEART
       tristate "'Lionheart' cpufreq governor"
       depends on CPU_FREQ
       help
         'Lionheart' - A brave and agile conservative-based governor.

config CPU_FREQ_GOV_LIONHEART_INPUT
       bool "Ramp up CPU frequency on input events"
       default y
       depends on CPU_FREQ_GOV_LIONHEART
       help
         Enable installation of an input event handler which will ramp up the
         CPU to max frequency when an input event is received.

config CPU_FREQ_GOV_BRAZILIANWAX
	tristate "'brazilianwax' cpufreq governor"
	depends on CPU_FREQ
	help
	  'brazilianwax' - a "slightly more agressive smart" optimized governor!

config CPU_FREQ_GOV_BRAZILIANWAX_INPUT
	bool "Ramp up CPU frequency on input events"
	default y
	depends on CPU_FREQ_GOV_BRAZILIANWAX
	help
	  Enable installation of an input event handler which will ramp up the
	  CPU to max frequency when an input event is received.

	  If in doubt, say N.

config CPU_FREQ_GOV_ONDEMANDX
       tristate "'ondemandx' cpufreq policy governor"
       select CPU_FREQ_TABLE
       help
        'ondemand' - This driver adds a dynamic cpufreq policy governor.
         The governor does a periodic polling and
         changes frequency based on the CPU utilization.
         The support for this governor depends on CPU capability to
         do fast frequency switching (i.e, very low latency frequency
         transitions).

         To compile this driver as a module, choose M here: the
         module will be called cpufreq_ondemand.

         For details, take a look at linux/Documentation/cpu-freq.

         If in doubt, say N.
	 
config CPU_FREQ_GOV_ONDEMANDX_INPUT
       bool "Ramp up CPU frequency on input events"
       default y
       depends on CPU_FREQ_GOV_ONDEMANDX
       help
         Enable installation of an input event handler which will ramp up the
         CPU to max frequency when an input event is received.

config CPU_FREQ_MIN_TICKS
	int "Ticks between governor polling interval."
	default 10
	help
	  Minimum number of ticks between polling interval for governors.

config CPU_FREQ_SAMPLING_LATENCY_MULTIPLIER
	int "Sampling rate multiplier for governors."
	default 1000
	help
	  Sampling latency rate multiplied by the cpu switch latency.
	  Affects governor polling.

config CPU_FREQ_USER_FREQS
	bool "CPUFREQ User Enable/Disable Frequencies via sysfs interface"
	depends on CPU_FREQ
	default n
	help
	  CPU Vdd levels sysfs interface

endif	# CPU_FREQ
```

## common/drivers/staging/frandom/Kconfig
```kconfig
config FRANDOM_SUPPORT
	tristate "FRANDOM: Fast pseudo-random number generator"
        default n
	help
	  Say [*] to add FRANDOM support to the kernel. 
          This speeds up the random generating of 10-50 times than
          normal URANDOM.
```

## modules/frandom/Kconfig
```kconfig
#FRANDOM_MODULE

config FRANDOM_MODULE
       tristate "FRANDOM: fast and entropy saving random number generation for the linux kernel"
       default M
       help
	 Say M to build the FRANDOM module.  This speeds up the random
	 generating of 10-50 times than normal URANDOM.
         Making this as inbuilt [*] is not tested and may not work.
```
